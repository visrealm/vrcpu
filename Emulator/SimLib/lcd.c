/*
 * Troy's 8-bit computer - Emulator
 *
 * Copyright (c) 2020 Troy Schrapel
 *
 * This code is licensed under the MIT license
 *
 * https://github.com/visrealm/vrcpu
 *
 */

#include "lcd.h"
#include <stdlib.h>
#include <memory.h>
#include <math.h>
#include <time.h>

#define CHAR_WIDTH  5
#define CHAR_HEIGHT 8
#define DATA_WIDTH 40
#define DATA_HEIGHT 4

static int rowOffsets[] = { 0x00, 0x40, 0x14, 0x54 };

static const byte fontA00[240][CHAR_WIDTH];
static const byte fontA02[240][CHAR_WIDTH];


struct LCD_s
{
  int width;
  int height;

  byte entryModeFlags;
  byte displayFlags;

  char* data;
  char* ptr;
  char* pixels;
  int scrollOffset;

  int pixelsWidth;
  int pixelsHeight;
  int numPixels;

  byte cgram[8][8];
  char* cgptr;

};

static void increment(LCD* lcd)
{
  ++lcd->ptr;
  size_t offset = lcd->ptr - lcd->data;
  if (offset >= (DATA_WIDTH)* lcd->height)
  {
    lcd->ptr = lcd->data;
  }
}

static void decrement(LCD* lcd)
{
  --lcd->ptr;
  if (lcd->ptr < lcd->data)
  {
    lcd->ptr = lcd->data + (DATA_WIDTH * lcd->height) - 1;
  }
}



DLLEXPORT LCD* newLCD(int width, int height)
{
  LCD* lcd = (LCD*)malloc(sizeof(LCD));
  if (lcd != NULL)
  {
    if (height > 4) height = 4;

    lcd->width = width;
    lcd->height = height;

    size_t datalen = DATA_WIDTH * height;
    lcd->data = (char*)malloc(datalen);
    if (lcd->data != NULL)
    {
      memset(lcd->data, ' ', datalen);
    }
    lcd->ptr = lcd->data;
    lcd->entryModeFlags = LCD_CMD_ENTRY_MODE_INCREMENT;
    lcd->displayFlags = 0;
    lcd->scrollOffset = 0;
    memset(lcd->cgram, 0xaa, sizeof(lcd->cgram));
    lcd->cgptr = NULL;
    lcd->pixelsWidth = lcd->width * (CHAR_WIDTH + 1) - 1;
    lcd->pixelsHeight = lcd->height * (CHAR_HEIGHT + 1) - 1;
    lcd->numPixels = lcd->pixelsWidth * lcd->pixelsHeight;
    lcd->pixels = (char*)malloc(lcd->numPixels);
    memset(lcd->pixels, -1, lcd->numPixels);
    updatePixels(lcd);
  }
  return lcd;
}

DLLEXPORT void destroyLCD(LCD* lcd)
{
  if (lcd)
  {
    free(lcd->data);
    free(lcd->pixels);
    memset(lcd, 0, sizeof(lcd));
    free(lcd);
  }
}

DLLEXPORT void sendCommand(LCD* lcd, byte command)
{
  if (command & LCD_CMD_SET_DRAM_ADDR)
  {
    int offset = (command & 0x7f);
    if (offset < 0)
    {
      offset = 0;
    }
    else if (offset >= DATA_WIDTH * lcd->height)
    {
      offset = DATA_WIDTH * lcd->height - 1;
    }
    lcd->ptr = lcd->data + offset;
    lcd->cgptr = NULL;
  }
  else if (command & LCD_CMD_SET_CGRAM_ADDR)
  {
    lcd->cgptr = (char*)lcd->cgram + (command & 0x3f);
  }
  else if (command & LCD_CMD_SHIFT)
  {
    if (command & LCD_CMD_SHIFT_DISPLAY)
    {
      if (command & LCD_CMD_SHIFT_RIGHT)
      {
        --lcd->scrollOffset;
      }
      else
      {
        ++lcd->scrollOffset;
      }
    }
    else
    {
      if (command & LCD_CMD_SHIFT_RIGHT)
      {
        increment(lcd);
      }
      else
      {
        decrement(lcd);
      }
    }
  }
  else if (command & LCD_CMD_DISPLAY)
  {
    lcd->displayFlags = command;
  }
  else if (command & LCD_CMD_ENTRY_MODE)
  {
    lcd->entryModeFlags = command;
  }
  else if (command & LCD_CMD_HOME)
  {
    lcd->ptr = lcd->data;
    lcd->scrollOffset = 0;
  }
  else if (command & LCD_CMD_CLEAR)
  {
    if (lcd->data != NULL)
    {
      size_t datalen = ((size_t)DATA_WIDTH) * lcd->height;
      memset(lcd->data, ' ', datalen);
    }
    lcd->ptr = lcd->data;
    lcd->scrollOffset = 0;
  }
}


void doShift(LCD* lcd)
{
  if (lcd->cgptr)
  {
    if (lcd->entryModeFlags & LCD_CMD_ENTRY_MODE_INCREMENT)
    {
      ++lcd->cgptr;
      if (lcd->cgptr >= (char*)lcd->cgram + sizeof(lcd->cgram))
      {
        lcd->cgptr = (char*)lcd->cgram;
      }
    }
    else
    {
      --lcd->cgptr;
      if (lcd->cgptr < (char*)lcd->cgram)
      {
        lcd->cgptr = (char*)lcd->cgram + sizeof(lcd->cgram) - 1;
      }
    }
  }
  else
  {
    if (lcd->entryModeFlags & LCD_CMD_ENTRY_MODE_SHIFT)
    {
      if (lcd->entryModeFlags & LCD_CMD_ENTRY_MODE_INCREMENT)
      {
        ++lcd->scrollOffset;
      }
      else
      {
        --lcd->scrollOffset;
      }
    }
    if (lcd->entryModeFlags & LCD_CMD_ENTRY_MODE_INCREMENT)
    {
      increment(lcd);
    }
    else
    {
      decrement(lcd);
    }
  }
}

DLLEXPORT void writeByte(LCD* lcd, byte data)
{
  if (lcd->cgptr)
  {
    // go to starting byte for the current character
    int row = (lcd->cgptr - (char*)lcd->cgram) % 8;
    byte* startAddr = lcd->cgptr - row;

    for (int i = 0; i < 5; ++i)
    {
      byte bit = data & (0x10 >> i);
      if (bit)
      {
        *(startAddr + i) |= (0x80 >> row);
      }
      else
      {
        *(startAddr + i) &= ~(0x80 >> row);
      }
    }
  }
  else
  {
    *lcd->ptr = data;
  }
  doShift(lcd);
}

DLLEXPORT byte readByte(LCD* lcd)
{
  byte data = 0;

  if (lcd->cgptr)
  {
    // go to starting byte for the current character
    int row = (lcd->cgptr - (char*)lcd->cgram) % 8;
    byte* startAddr = lcd->cgptr - row;

    for (int i = 0; i < 5; ++i)
    {
      if (*(startAddr + i) & (0x80 >> row))
      {
        data |= (0x10 >> i);
      }
    }
  }
  else
  {
    data = *lcd->ptr;
  }

  doShift(lcd);

  return data;
}


DLLEXPORT void writeString(LCD* lcd, const char* str)
{
  const char* ptr = str;
  while (*ptr != '\0')
  {
    writeByte(lcd, *ptr);
    ++ptr;
  }
}


DLLEXPORT const char* readLine(LCD* lcd, int row)
{
  return lcd->data + (row * (lcd->width + 1));
}

DLLEXPORT const byte* charBits(LCD* lcd, byte c)
{
  static const int CGRAM_SIZE = 16;
  if (c < CGRAM_SIZE)
  {
    return lcd->cgram[c % 8];
  }
  return fontA02[c - CGRAM_SIZE];
}

DLLEXPORT int getDataOffset(LCD* lcd, int row, int col)
{
  int offset = col % DATA_WIDTH;
  if (col < 0)
  {
    offset = DATA_WIDTH + offset;
  }
  return (row * DATA_WIDTH) + offset;
}

DLLEXPORT void updatePixels(LCD* lcd)
{
  char* pixel = lcd->pixels;

  int cursorOn = lcd->displayFlags & 0x03;
  if (lcd->displayFlags & LCD_CMD_DISPLAY_CURSOR_BLINK)
  {
    if (((clock() / (CLOCKS_PER_SEC / 1000)) % 700) < 350)
    {
      cursorOn &= ~LCD_CMD_DISPLAY_CURSOR_BLINK;
    }
  }

  int displayOn = lcd->displayFlags & LCD_CMD_DISPLAY_ON;

  for (int row = 0; row < lcd->height; ++row)
  {
    for (int col = 0; col < lcd->width; ++col)
    {
      char* charTopLeft = lcd->pixels + (row * (CHAR_HEIGHT + 1) * lcd->pixelsWidth) + col * (CHAR_WIDTH + 1);

      int dataCol = col + lcd->scrollOffset;

      char* ptr = lcd->data + getDataOffset(lcd, row, dataCol);

      int drawCursor = cursorOn && (ptr == lcd->ptr);

      char c = *ptr;

      const byte* bits = charBits(lcd, c);

      for (int y = 0; y < CHAR_HEIGHT; ++y)
      {
        pixel = charTopLeft + y * lcd->pixelsWidth;
        for (int x = 0; x < CHAR_WIDTH; ++x)
        {
          if (!displayOn)
          {
            *pixel = 0;
            continue;
          }

          *pixel = (bits[x] & (0x80 >> y)) ? 1 : 0;

          if (drawCursor)
          {
            *pixel = (cursorOn & LCD_CMD_DISPLAY_CURSOR_BLINK) || ((cursorOn & LCD_CMD_DISPLAY_CURSOR) && y == CHAR_HEIGHT - 1);
          }

          ++pixel;
        }
      }
    }
  }
}

DLLEXPORT void numPixels(LCD* lcd, int* width, int* height)
{
  if (width)* width = lcd->pixelsWidth;
  if (height)* height = lcd->pixelsHeight;
}

DLLEXPORT char pixelState(LCD* lcd, int x, int y)
{
  int offset = y * lcd->pixelsWidth + x;
  if (offset >= 0 && offset < lcd->numPixels)
    return lcd->pixels[offset];
  return -1;
}

// A00 (Japanese) character set. 
// skip first 16 characters reserved for CGRAM
static const byte fontA00[240][CHAR_WIDTH] = {
  {0x00, 0x00, 0x00, 0x00, 0x00}, //  16 -
  {0x00, 0x00, 0x00, 0x00, 0x00}, //  17 -
  {0x00, 0x00, 0x00, 0x00, 0x00}, //  18 -
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  {0xff, 0xff, 0xff, 0xff, 0xff}  // 255 -
};


// A02 (European) character set. 
// skip first 16 characters reserved for CGRAM
static const byte fontA02[240][CHAR_WIDTH] = {
 {0x00, 0x7f, 0x3e, 0x1c, 0x08}, //  16 -
 {0x08, 0x1c, 0x3e, 0x7f, 0x00}, //  17 -
 {0x30, 0x50, 0x00, 0x30, 0x50}, //  18 -
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 {0x18, 0x45, 0x05, 0x45, 0x1e}, // 255 - ÿ
};